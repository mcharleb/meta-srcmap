## conf/layer.conf
```bitbake
# We have a conf and classes directory, add to BBPATH
BBPATH .= ":${LAYERDIR}"

BBFILE_COLLECTIONS += "srcmap"
BBFILE_PATTERN_srcmap = "^${LAYERDIR}/"
BBFILE_PRIORITY_srcmap = "6"
```
